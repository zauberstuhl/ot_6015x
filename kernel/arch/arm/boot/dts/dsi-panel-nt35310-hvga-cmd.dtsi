/* Copyright (c) 2013, The Linux Foundation. All rights reserved.
 *
 * This program is free software; you can redistribute it and/or modify
 * it under the terms of the GNU General Public License version 2 and
 * only version 2 as published by the Free Software Foundation.
 *
 * This program is distributed in the hope that it will be useful,
 * but WITHOUT ANY WARRANTY; without even the implied warranty of
 * MERCHANTABILITY or FITNESS FOR A PARTICULAR PURPOSE.  See the
 * GNU General Public License for more details.
 */

/*---------------------------------------------------------------------------
 * This file is autogenerated file using gcdb parser. Please do not edit it.
 * Update input XML file to add a new entry or update variable in this file
 * VERSION = "1.0"
 *---------------------------------------------------------------------------*/
&mdss_mdp {
	dsi_nt35310_hvga_cmd: qcom,mdss_dsi_nt35310_hvga_cmd {
		qcom,mdss-dsi-panel-name = "NT35310 hvga  cmd mode dsi panel";
		qcom,mdss-dsi-panel-controller = <&mdss_dsi0>;
		qcom,mdss-dsi-panel-type = "dsi_cmd_mode";
		qcom,mdss-dsi-panel-destination = "display_1";
		qcom,mdss-dsi-panel-framerate = <60>;
		qcom,mdss-dsi-virtual-channel-id = <0>;
		qcom,mdss-dsi-stream = <0>;
		qcom,mdss-dsi-panel-width = <320>;
		qcom,mdss-dsi-panel-height = <480>;
		qcom,mdss-dsi-h-front-porch = <80>;
		qcom,mdss-dsi-h-back-porch = <54>;
		qcom,mdss-dsi-h-pulse-width = <8>;
		qcom,mdss-dsi-h-sync-skew = <0>;
		qcom,mdss-dsi-v-front-porch = <12>;
		qcom,mdss-dsi-v-back-porch = <16>;
		qcom,mdss-dsi-v-pulse-width = <2>;
		qcom,mdss-dsi-h-left-border = <0>;
		qcom,mdss-dsi-h-right-border = <0>;
		qcom,mdss-dsi-v-top-border = <0>;
		qcom,mdss-dsi-v-bottom-border = <0>;
		qcom,mdss-dsi-bpp = <18>;
		qcom,mdss-dsi-color-order = <0>;
		qcom,mdss-dsi-underflow-color = <0xff>;
		qcom,mdss-dsi-border-color = <0>;
		qcom,mdss-dsi-on-command = [
			39 01 00 00 00 00 03
				ED 01 FE
			39 01 00 00 60 00 03
				EE DE 21 
			39 01 00 00 00 00 02
				F3 00
			39 01 00 00 00 00 02
				F1 01	
			39 01 00 00 00 00 02
				DF 10	
			39 01 00 00 00 00 05
				C0 44 44 10 10 	
			39 01 00 00 00 00 02
				B4 0D		
			39 01 00 00 00 00 02
				C4 6a		
			39 01 00 00 00 00 02
				BF AA				
			39 01 00 00 00 00 13
				B0 0D 00  0D
				00 11 00 19
				00 21 00 2D
				00 3D 00 5D
				00 5D 00		
			39 01 00 00 00 00 07
				B1 80 00 8B
				00 96 00
			39 01 00 00 00 00 07
				B2 00 00 02
				00 03 00
			39 01 00 00 00 00 19
				B3 00 00 00
				00 00 00 00
				00 00 00 00
				00 00 00 00
				00 00 00 00
				00 00 00 00 00	
			39 01 00 00 00 00 07
				B4 8B 00 96
				00 A1 00			
			39 01 00 00 00 00 07
				B5 02 00 03
				00 04 00
			39 01 00 00 00 00 03
				B6 00 00 
			39 01 00 00 00 00 09
				B8 00 00 00
				00 00 00 00 00
			39 01 00 00 00 00 05
				C2 0A 00 04 00	
			39 01 00 00 00 00 05
				C7 00 00 00 00	
			39 01 00 00 00 00 11
				C9 00 00 00
				00 00 00 00
				00 00 00 00
				00 00 00 00 00	
			39 01 00 00 00 00 17
				B7 3F 00 5E
				00 9E 00 74
				00 8C 00 AC
				00 DC 00 70
				00 B9 00 EC
				00 DC 00		
			39 01 00 00 00 00 25
				E0 01 00 07
				00 19 00 3A
				00 4E 00 5C
				00 6E 00 85
				00 93 00 9F
				00 AA 00 B7
				00 C0 00 C5
				00 CC 00 D0
				00 D9 00 F3 00		
			39 01 00 00 00 00 25
				E1 01 00 07
				00 19 00 3A
				00 4E 00 5C
				00 6E 00 85
				00 93 00 9F
				00 AA 00 B7
				00 C0 00 C5
				00 CC 00 D0
				00 D9 00 F3 00				
			39 01 00 00 00 00 25
				E2 01 00 07
				00 19 00 3A
				00 4E 00 5C
				00 6E 00 85
				00 93 00 9F
				00 AA 00 B7
				00 C0 00 C5
				00 CC 00 D0
				00 D9 00 F3 00			
			39 01 00 00 00 00 25
				E3 01 00 07
				00 19 00 3A
				00 4E 00 5C
				00 6E 00 85
				00 93 00 9F
				00 AA 00 B7
				00 C0 00 C5
				00 CC 00 D0
				00 D9 00 F3 00
			39 01 00 00 00 00 25
				E4 01 00 07
				00 19 00 3A
				00 4E 00 5C
				00 6E 00 85
				00 93 00 9F
				00 AA 00 B7
				00 C0 00 C5
				00 CC 00 D0
				00 D9 00 F3 00			
			39 01 00 00 00 00 25
				E5 01 00 07
				00 19 00 3A
				00 4E 00 5C
				00 6E 00 85
				00 93 00 9F
				00 AA 00 B7
				00 C0 00 C5 
				00 CC 00 D0
				00 D9 00 F3 00			
			39 01 00 00 00 00 21
				E6 21 00 55
				00 99 00 77
				00 77 00 76
				00 78 00 98
				00 BB 00 99
				00 66 00 54
				00 45 00 34
				00 44 00 34 00			
			39 01 00 00 00 00 21
				E7 21 00 55
				00 99 00 77
				00 77 00 76
				00 78 00 98
				00 BB 00 99
				00 66 00 54
				00 45 00 34
				00 44 00 34 00			
			39 01 00 00 00 00 21
				E8 21 00 55
				00 99 00 77
				00 77 00 76
				00 78 00 98
				00 BB 00 99
				00 66 00 54
				00 45 00 34
				00 44 00 34 00			
			39 01 00 00 00 00 05
				E9 AA 00 00 00			
			39 01 00 00 00 00 02
				00 AA	
			39 01 00 00 00 00 12
				CF 00 00 00
				00 00 00 00
				00 00 00 00
				00 00 00 00
				00 00	
			39 01 00 00 00 00 06
				F0 00 50 00 00 00
			39 01 00 00 00 00 03
				EE DE 21			
			39 01 00 00 00 00 02
				F3 00			
			39 01 00 00 00 00 02
				B3 20			
			39 01 00 00 00 00 02
				35 00			
			39 01 00 00 00 00 02
				36 00			
			39 01 00 00 00 00 02
				3A 66			
			05 01 00 00 78 00 02
				11  00
			05 01 00 00 30 00 02
				29  00
			];
		qcom,mdss-dsi-off-command = [05 01 00 00 32 00 02 28 00
					05 01 00 00 78 00 02 10 00];
		qcom,mdss-dsi-on-command-state = "dsi_lp_mode";
		qcom,mdss-dsi-off-command-state = "dsi_lp_mode";
		qcom,mdss-dsi-h-sync-pulse = <1>;
		qcom,mdss-dsi-traffic-mode = <0>;
		qcom,mdss-dsi-lane-map = <0>;
		qcom,mdss-dsi-bllp-eof-power-mode;
		qcom,mdss-dsi-bllp-power-mode;
		qcom,mdss-dsi-lane-0-state;
		qcom,mdss-dsi-panel-timings = [68 16 0E  00 38 3C 12 19 18 03 04 00];
		qcom,mdss-dsi-t-clk-post = <0x04>;
		qcom,mdss-dsi-t-clk-pre = <0x1b>;
		qcom,mdss-dsi-bl-min-level = <1>;
		qcom,mdss-dsi-bl-max-level = <255>;
		qcom,mdss-dsi-dma-trigger = <4>;
		qcom,mdss-dsi-mdp-trigger = <0>;
		qcom,mdss-dsi-bl-pmic-control-type = "bl_ctrl_wled";
		qcom,mdss-dsi-reset-sequence = <1 1>, <0 10>, <1 120>;

	};
};

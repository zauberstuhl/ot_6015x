/* Copyright (c) 2013, The Linux Foundation. All rights reserved.
 *
 * This program is free software; you can redistribute it and/or modify
 * it under the terms of the GNU General Public License version 2 and
 * only version 2 as published by the Free Software Foundation.
 *
 * This program is distributed in the hope that it will be useful,
 * but WITHOUT ANY WARRANTY; without even the implied warranty of
 * MERCHANTABILITY or FITNESS FOR A PARTICULAR PURPOSE.  See the
 * GNU General Public License for more details.
 */

qcom,qrd-4v35-1700mAh-data-TLp017A2 {
	qcom,fcc-mah = <1700>;
	qcom,default-rbatt-mohm = <216>;
	qcom,rbatt-capacitive-mohm = <50>;
	qcom,flat-ocv-threshold-uv = <3800000>;
	qcom,max-voltage-uv = <4350000>;
	qcom,v-cutoff-uv = <3400000>;
	qcom,chg-term-ua = <100000>;
	qcom,batt-id-kohm = <200>;

	qcom,rbatt-sf-lut {
		qcom,lut-col-legend = <(-20) 0 25 40 60>;
		qcom,lut-row-legend = <100 95 90 85 80>,
				<75 70 65 60 55>,
				<50 45 40 35 30>,
				<25 20 16 13 11>,
				<10 9 8 7 6>,
				<5 4 3 2 1 0>;
	qcom,lut-data = < 1084  291  100  74  69  >,
				< 1009  294  103  76  70  >,
				< 983  296  107  79  72  >,
				< 984  297  111  82  75  >,
				< 943  302  116  85  77  >,
				< 954  289  123  89  79  >,
				< 963  290  127  94  83  >,
				< 610  293  127  100  86  >,
				< 1023  294  107  85  81  >,
				< 1071  296  104  76  71  >,
				< 1124  296  106  78  73  >,
				< 1039  300  110  81  76  >,
				< 1080  316  114  83  80  >,
				< 1513  338  117  85  81  >,
				< 1753  377  122  87  72  >,
				< 1908  428  132  85  74  >,
				< 2091  476  137  87  75  >,
				< 2223  510  139  84  74  >,
				< 2228  519  139  84  71  >,
				< 1904  483  138  84  72  >,
				< 2018  498  138  84  73  >,
				< 2161  515  141  86  75  >,
				< 2334  538  146  89  77  >,
				< 2542  561  153  92  78  >,
				< 2790  590  161  95  80  >,
				< 3116  622  170  100  80  >,
				< 3511  659  179  103  77  >,
				< 4064  716  189  102  77  >,
 				< 4785  794  188  98  80  >,
				< 5844  983  198  103  84  >,
				< 7479  1515  217  110  89  >;
	};

	qcom,fcc-temp-lut {
		qcom,lut-col-legend = <(-20) 0 25 40 60>;
		qcom,lut-data = <1700 1700 1750 1750 1700>;
	};

	qcom,pc-temp-ocv-lut {
		qcom,lut-col-legend = <(-20) 0 25 40 60>;
		qcom,lut-row-legend = <100 95 90 85 80>,
				<75 70 65 60 55>,
				<50 45 40 35 30>,
				<25 20 16 13 11>,
				<10 9 8 7 6>,
				<5 4 3 2 1>,
				<0>;
		qcom,lut-data = < 4331  4333  4343  4337  4324  >,
				< 4236  4246  4280  4277  4264  >,
				< 4165  4188  4225  4222  4209  >,
				< 4101  4132  4171  4168  4156  >,
				< 4057  4077  4118  4116  4105  >,
				< 3970  4024  4069  4066  4056  >,
				< 3927  3971  4021  4020  4011  >,
				< 3881  3930  3978  3978  3970  >,
				< 3843  3891  3938  3940  3933  >,
				< 3816  3856  3884  3889  3888  >,
				< 3797  3827  3850  3850  3847  >,
				< 3780  3800  3824  3825  3823  >,
				< 3765  3779  3803  3804  3803  >,
				< 3740  3766  3786  3785  3785  >,
				< 3731  3753  3771  3770  3769  >,
				< 3716  3739  3759  3758  3743  >,
				< 3698  3724  3747  3740  3723  >,
				< 3681  3710  3725  3720  3703  >,
				< 3665  3698  3704  3698  3677  >,
				< 3655  3688  3689  3681  3663  >,
				< 3651  3683  3681  3673  3661  >,
				< 3644  3678  3678  3671  3660  >,
				< 3636  3673  3675  3669  3659  >,
				< 3627  3668  3673  3668  3658  >,
				< 3617  3662  3670  3666  3656  >,
				< 3605  3651  3668  3664  3652  >,
				< 3592  3630  3665  3661  3646  >,
				< 3574  3594  3660  3656  3628  >,
				< 3552  3543  3649  3642  3591  >,
				< 3522  3473  3618  3605  3546  >,
				< 3400  3400  3400  3400  3400  >;
	};
};
